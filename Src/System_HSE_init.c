/* Includes ------------------------------------------------------------------*/
#include "stm32l162xe.h"
void SystemInit (void)
{     
        RCC->AHBENR     |= RCC_AHBENR_GPIOHEN;                     // enable clock for port H
        
        
        if ((RCC->CFGR & RCC_CFGR_SWS) == RCC_CFGR_SWS_PLL)     // #define  RCC_CFGR_SWS_PLL    ((uint32_t)0x00000008)   /*!< PLL used as system clock */
        //Биты 3: 2 SWS [1: 0]: состояние переключателя системных часов
        //00: генератор HSI используется в качестве системных часов
        //01: генератор HSE используется в качестве системных часов
        //10: PLL используется в качестве системных часов
        //11: генератор HSI48, используемый в качестве системных часов (при наличии)
    	{ 
    	 RCC->CFGR &= (uint32_t) (~RCC_CFGR_SW);        // #define  RCC_CFGR_SW ((uint32_t)0x00000003)  /*!< SW[1:0] bits (System clock Switch) */
        //Биты 1: 0 SW [1: 0]: переключатель системных часов
        // Сбрасывается аппаратным обеспечением для принудительного выбора HSI при выходе
        // из режима остановки и ожидания или в случае сбоя генератора HSE,
        // используемого прямо или косвенно в качестве системных часов (если включена система обеспечения безопасности часов).
        //00: HSI выбран в качестве системных часов
        //01: HSE выбран в качестве системных часов
        //10: PLL выбран в качестве системных часов
        //11: HSI48 выбран в качестве системных часов (если доступно)
    	 while ((RCC->CFGR & RCC_CFGR_SWS) != RCC_CFGR_SWS_HSI) {}; // Пока не сбросится HSI
    	}
        
    	RCC->CR |= ((uint32_t)RCC_CR_HSEON);
        // HSEON: включение часов HSE
        // Сбрасывается аппаратно для остановки генератора HSE при переходе в режим остановки или ожидания.
        // Этот бит не может быть сброшен, если генератор HSE прямо или косвенно используется в качестве системных часов.
        //0: генератор HSE выключен
        //1: генератор HSE включен
    	while(!(RCC->CR & RCC_CR_HSERDY));
        //Бит 17 HSERDY: флаг готовности часов HSE
        // Устанавливается аппаратно, чтобы указать, что генератор HSE стабилен. Этот бит требует 6 циклов
        // тактового генератора HSE для сброса после сброса HSEON.
        //0: генератор HSE не готов
        //1: генератор HSE готов
        
        FLASH->ACR = FLASH_ACR_ACC64;
        FLASH->ACR |= FLASH_ACR_PRFTEN | FLASH_ACR_LATENCY;
        //Бит 4 PRFTBE: включение буфера предварительной выборки
        //0: предварительная выборка отключена
        //1: Предварительная выборка включена
        //Биты 2: 0 LATENCY [2: 0]: задержка
        // Эти биты представляют отношение периода SYSCLK (системные часы) к времени доступа к Flash.
        //000: нулевое состояние ожидания, если SYSCLK <= 24 МГц
        //001: одно состояние ожидания, если 24 МГц <SYSCLK <= 48 МГц
        
        // https://community.st.com/s/question/0D50X00009XkYwWSAV/stm32l-clock-issue
        RCC->APB1ENR |= RCC_APB1ENR_PWREN;
        // Когда периферийные часы не активны, значения регистров периферийных устройств могут не читаться программным обеспечением, а возвращаемое значение всегда равно 0x0.
        //PWREN: тактовый интерфейс питания включен
        //Этот бит устанавливается и сбрасывается программным обеспечением.
        //0: часы интерфейса питания отключены
        //1: включение синхронизации интерфейса питания
        RCC->APB1ENR |= RCC_APB1ENR_COMPEN;
        RCC->APB2ENR |= RCC_APB2ENR_SYSCFGEN;
        
        PWR->CR = PWR_CR_VOS_0;                 // __HAL_PWR_VOLTAGESCALING_CONFIG(PWR_REGULATOR_VOLTAGE_SCALE1);
        while((PWR->CSR & PWR_CSR_VOSF)) {};    // #define PWR_REGULATOR_VOLTAGE_SCALE1       PWR_CR_VOS_0
        // 5.1.6 Конфигурация динамического масштабирования напряжения
        //  Для программирования диапазонов регулятора напряжения требуется следующая последовательность действий:
        //  1. Проверьте VDD, чтобы определить, какие диапазоны разрешены (см. Рисунок 9: производительность STM32L1xxxx по сравнению с диапазоном VDD и VCORE).
        //  2. Опрос VOSF бит в PWR_CSR. Подождите, пока он не будет сброшен до 0.
        //  3. Настройте диапазон масштабирования напряжения, установив биты VOS [12:11] в регистре PWR_CR.
        //  4. Опросить бит VOSF в регистре PWR_CSR. Подождите, пока он не будет сброшен до 0.
        //  Примечание. Во время настройки масштабирования напряжения системные часы останавливаются до стабилизации регулятора (VOSF = 0).
        //  Это необходимо учитывать при разработке приложения, если требуется критическое время реакции на прерывание,
        //  и в зависимости от используемого периферийного устройства (таймер, связь, ...).
        
        // Если что в нащем случае RCC_CFGR_HPRE_DIV1 = RCC_CFGR_PPRE1_DIV1 = RCC_CFGR_PPRE2_DIV1 = 0.
        RCC->CFGR |= RCC_CFGR_HPRE_DIV1;        // AHB = SYSCLK/1
	RCC->CFGR |= RCC_CFGR_PPRE1_DIV1;       // APB1 = HCLK/1
	RCC->CFGR |= RCC_CFGR_PPRE2_DIV1;       // APB2 = HCLK/1
        
        RCC->CR &= (uint32_t)(~RCC_CR_PLLON);
        //Бит 24 PLLON: включение PLL
        //Сбрасывается аппаратно при переходе в режим остановки или ожидания. Этот бит не может быть сброшен,
        //если часы PLL используются в качестве системных часов или выбраны, чтобы стать системными часами.
        //0: PLL OFF
        //1: PLL ON
        
    	while(RCC->CR & RCC_CR_PLLRDY) {};
        //Бит 25 PLLRDY: флаг готовности часов PLL
        // Установить аппаратно, чтобы указать, что PLL заблокирован.
        //0: PLL разблокирована
        //1: PLL заблокирован
        
        //PLL input = HSE = 8 МГц
    	RCC->CFGR |= RCC_CFGR_PLLSRC_HSE;
        RCC->CFGR |= RCC_CFGR_PLLDIV3 | RCC_CFGR_PLLMUL12;      // Иначе не будет 48 МГц на USB
        //00: not allowed
        //01: PLL clock output = PLLVCO / 2
        //10: PLL clock output = PLLVCO / 3
        //11: PLL clock output = PLLVCO / 4
        
        //0000: PLLVCO = PLL clock entry x 3
        //0001: PLLVCO = PLL clock entry x 4
        //0010: PLLVCO = PLL clock entry x 6
        //0011: PLLVCO = PLL clock entry x 8
        //0100: PLLVCO = PLL clock entry x 12
        //0101: PLLVCO = PLL clock entry x 16
        //0110: PLLVCO = PLL clock entry x 24
        //0111: PLLVCO = PLL clock entry x 32
        //1000: PLLVCO = PLL clock entry x 48
        
        //Turn PLL on
        RCC->CR |= RCC_CR_PLLON;
        //Wait PLL to stabilize
        while (!(RCC->CR & RCC_CR_PLLRDY));

        
    	
    	
        //Set PLL as SYSCLK
    	RCC->CFGR |= RCC_CFGR_SW_PLL | RCC_CFGR_SWS_PLL;
        while ((RCC->CFGR & RCC_CFGR_SWS) != RCC_CFGR_SWS_PLL) {};
        
        //Turn off MSI
//    	RCC->CR&=~RCC_CR_MSION; // Internal Multi Speed clock enable
    	
}

// 6.3.3 Регистр конфигурации часов (RCC_CFGR)     (RM0038, pg. 141)
// Смещение адреса: 0x08
// Сбросить значение: 0x0000 0000
// Доступ: 0 <= состояние ожидания <= 2, доступ к слову, полуслову и байту 1 или 2 состояния ожидания вставляются, только если доступ происходит во время переключения источника синхронизации.

// Биты 31 Зарезервированы, должны быть сохранены в значении сброса.

// Биты 30:28 MCOPRE [2:0]: прескейлер тактового выхода микроконтроллера
// Эти биты устанавливаются и очищаются программным обеспечением.
// Настоятельно рекомендуется изменить этот прескалер до того, как будет включен выход MCO.
      //000: MCO делится на 1
      //001: MCO делится на 2
      //010: MCO делится на 4
      //011: MCO делится на 8
      //100: MCO делится на 16
      //Другие: не допускаются

// Биты 27 Зарезервированы, должны быть сохранены при значении сброса.

// Биты 26:24 MCOSEL [2:0]: выбор тактового выхода микроконтроллера
// Эти биты устанавливаются и очищаются программным обеспечением.
      //000: выход MCO отключен, нет часов на MCO
      //001: выбраны часы SYSCLK
      //010: выбраны тактовые импульсы HSI
      //011: выбраны тактовые импульсы MSI
      //100: выбраны часы генератора HSE
      //101: выбраны часы PLL
      //110: выбраны тактовые импульсы LSI
      //111: выбраны тактовые импульсы LSE
// Примечание. Этот тактовый выход может иметь несколько усеченных циклов при запуске или во время переключения источника синхронизации MCO.

// Биты 23:22 PLLDIV [1:0]: деление выходных сигналов ФАПЧ
// Эти биты устанавливаются и очищаются программным обеспечением для управления делением тактовой частоты выходных сигналов ФАПЧ на тактовую частоту ФАПЧ.
// Эти биты могут быть записаны только когда PLL отключен.
      //00: не допускается
      //01: выходной сигнал PLL = PLLVCO / 2
      //10: выходной сигнал PLL = PLLVCO / 3
      //11: выходной сигнал PLL = PLLVCO / 4

// Биты 21:18 PLLMUL [3:0]: коэффициент умножения ФАПЧ
// Эти биты записываются программным обеспечением для определения коэффициента умножения ФАПЧ для генерации тактового сигнала ФАПЧ ФАПЧ.
// Эти биты могут быть записаны только когда PLL отключен.
      //0000: выходной сигнал PLL = PLLVCO х 3
      //0001: выходной сигнал PLL = PLLVCO x 4
      //0010: выходной сигнал PLL = PLLVCO x 6
      //0011: выходной сигнал PLL = PLLVCO x 8
      //0100: выходной сигнал PLL = PLLVCO x 12
      //0101: выходной сигнал PLL = PLLVCO x 16
      //0110: выходной сигнал PLL = PLLVCO x 24
      //0111: выходной сигнал PLL = PLLVCO x 32
      //1000: выходной сигнал PLL = PLLVCO x 48
      //другие: не допускаются
// Внимание: тактовая частота PLL VCO не должна превышать 96 МГц, когда продукт находится в диапазоне 1,
// 48 МГц, когда продукт находится в диапазоне 2, и 24 МГц, когда продукт находится в диапазоне 3.

// Бит 17 зарезервирован, необходимо сохранить значение сброса.

// Бит 16 PLLSRC: источник синхронизации входа PLL
// Этот бит устанавливается и очищается программным обеспечением для выбора источника синхронизации PLL. Этот бит может быть записан только когда PLL отключен.
      //0: тактовый генератор HSI выбран в качестве входного тактового сигнала ФАПЧ
      //1: тактовый генератор HSE выбран в качестве входного тактового сигнала ФАПЧ
// Примечание. Минимальная входная тактовая частота ФАПЧ составляет 2 МГц.

// Биты 15:14 Зарезервированы, должны быть сохранены на уровне сброса.

// Биты 13:11 PPRE2 [2:0]: высокоскоростной прескалер APB (APB2)
// Эти биты устанавливаются и очищаются программным обеспечением для управления коэффициентом деления высокоскоростного тактового сигнала APB (PCLK2).
      //0xx: HCLK не делится
      //100: HCLK делится на 2
      //101: HCLK делится на 4
      //110: HCLK делится на 8
      //111: HCLK делится на 16
// Биты 10:8 PPRE1 [2:0]: низкоскоростной прескалер APB (APB1)
// Эти биты устанавливаются и очищаются программным обеспечением для управления коэффициентом деления тактового сигнала низкой скорости APB (PCLK1).
      //0xx: HCLK не делится
      //100: HCLK делится на 2
      //101: HCLK делится на 4
      //110: HCLK делится на 8
      //111: HCLK делится на 16

// Биты 7:4 HPRE [3:0]: прескалер AHB
// Эти биты устанавливаются и очищаются программным обеспечением для управления коэффициентом деления тактового сигнала AHB.
// Внимание: в зависимости от диапазона напряжения устройства программное обеспечение должно правильно установить эти биты,
// чтобы частота системы не превышала максимально допустимую частоту (более подробную информацию см. и разделе «Управление динамическим масштабированием напряжения» в главе PWR.)
// После Операция записи в эти биты и перед уменьшением диапазона напряжения необходимо прочитать этот регистр, чтобы убедиться, что новое значение было учтено.
      //0xxx: SYSCLK не делится
      //1000: SYSCLK делится на 2
      //1001: SYSCLK делится на 4
      //1010: SYSCLK делится на 8
      //1011: SYSCLK делится на 16
      //1100: SYSCLK делится на 64
      //1101: SYSCLK делится на 128
      //1110: SYSCLK делится на 256
      //1111: SYSCLK делится на 512

// Биты 3:2 SWS [1:0]: состояние переключателя системных часов
// Эти биты устанавливаются и очищаются аппаратно, чтобы указать, какой источник синхронизации используется в качестве системных часов.
      //00: MSI генератор используется в качестве системных часов
      //01: HSI генератор используется в качестве системных часов
      //10: HSE генератор, используемый в качестве системных часов
      //11: PLL используется в качестве системных часов

// Биты 1:0 SW [1:0]: переключатель системных часов
// Эти биты устанавливаются и очищаются программным обеспечением для выбора источника SYSCLK.
// Устанавливается аппаратно для принудительного выбора MSI при выходе из режимов «Стоп» и «Ожидание» или в случае отказа генератора HSE,
// используемого прямо или косвенно в качестве системных часов (если включена система обеспечения безопасности часов).
      //00: MSI генератор используется в качестве системных часов
      //01: HSI генератор используется в качестве системных часов
      //10: HSE генератор, используемый в качестве системных часов
      //11: PLL используется в качестве системных часов

// 7.3.14 Использование выводов OSC_IN / OSC_OUT в качестве выводов порта GPIO PH0 / PH1
// Выводы генератора HSE OSC_IN / OSC_OUT могут использоваться как универсальные входы / выходы PH0 / PH1, соответственно, когда генератор HSE выключен.
// (после сброса генератор HSE выключен). Входы / выходы PH0 / PH1 конфигурируются как осцилляторы HSE OSC_IN / OSC_OUT, когда генератор HSE включен.
// Это делается путем установки бита HSEON в регистре RCC_CR. HSE имеет приоритет над функцией GPIO.
    	